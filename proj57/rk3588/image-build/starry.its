## proj57/rk3588/image-build/starry.its
```
/dts-v1/;
/ {
    description = "StarryOS for Orange Pi 5 Plus";
    #address-cells = <1>;
    images {
        kernel-1 {
            data = /incbin/("starryos.bin");
            type = "kernel"; arch = "arm64"; os = "linux";
            compression = "none";
            load  = <0x02000000>;
            entry = <0x02000000>;
            hash-1 { algo = "sha256"; };
        };
        fdt-1 {
            data = /incbin/("starry.dtb");
            type = "flat_dt"; arch = "arm64";
            compression = "none";
            hash-1 { algo = "sha256"; };
        };
    };
    configurations {
        default = "config-1";
        config-1 { kernel = "kernel-1"; fdt = "fdt-1"; };
    };
};
```

## sg2002/wifi-ebpf/ebpf/boot-sg2002-noinitrd.its
```
/dts-v1/;

/*
 * SG2002 (LicheeRV Nano) FIT for the Cvitek U-Boot, without a ramdisk slot.
 *
 * The boot chain fixes the configuration and fdt node names, and the kernel
 * load address, so those stay as the board expects them. What is dropped is
 * the ramdisk: the kernel now reads the range U-Boot patches into /chosen as
 * a host initramfs and refuses anything that is not one, while the archive
 * the official image ships in that slot is Cvitek's own Linux ramdisk. The
 * root filesystem comes from the SD card's second partition either way.
 */

/ {
    description = "StarryOS for SG2002 LicheeRV Nano";
    #address-cells = <1>;

    images {
        kernel-1 {
            description = "StarryOS kernel";
            data = /incbin/("starryos.bin");
            type = "kernel";
            arch = "riscv";
            os = "linux";
            compression = "none";
            load = <0x80200000>;
            entry = <0x80200000>;
            hash-1 {
                algo = "crc32";
            };
        };

        fdt-sg2002_licheervnano_sd {
            description = "cvitek device tree - sg2002_licheervnano_sd";
            data = /incbin/("licheerv-nano-sg2002.dtb");
            type = "flat_dt";
            arch = "riscv";
            compression = "none";
            hash-1 {
                algo = "sha256";
            };
        };
    };

    configurations {
        default = "config-sg2002_licheervnano_sd";
        config-sg2002_licheervnano_sd {
            description = "StarryOS boot for sg2002_licheervnano_sd";
            kernel = "kernel-1";
            fdt = "fdt-sg2002_licheervnano_sd";
        };
    };
};
```

## sg2002/wifi-opt/sg2002-wifi-irq/sg2002-image-build/templates/boot.its
```
/dts-v1/;

/ {
    description = "StarryOS for SG2002 LicheeRV Nano";
    #address-cells = <1>;

    images {
        kernel-1 {
            description = "StarryOS kernel";
            data = /incbin/("starryos.bin");
            type = "kernel";
            arch = "riscv";
            os = "linux";
            compression = "none";
            load = <0x80200000>;
            entry = <0x80200000>;
            hash-1 {
                algo = "crc32";
            };
        };

        ramdisk-1 {
            description = "cvitek ramdisk";
            data = /incbin/("ramdisk.bin");
            type = "ramdisk";
            arch = "riscv";
            os = "linux";
            compression = "none";
            hash-1 {
                algo = "crc32";
            };
        };

        fdt-sg2002_licheervnano_sd {
            description = "cvitek device tree - sg2002_licheervnano_sd";
            data = /incbin/("licheerv-nano-sg2002.dtb");
            type = "flat_dt";
            arch = "riscv";
            compression = "none";
            hash-1 {
                algo = "sha256";
            };
        };
    };

    configurations {
        default = "config-sg2002_licheervnano_sd";
        config-sg2002_licheervnano_sd {
            description = "StarryOS boot for sg2002_licheervnano_sd";
            kernel = "kernel-1";
            ramdisk = "ramdisk-1";
            fdt = "fdt-sg2002_licheervnano_sd";
        };
    };
};
```
